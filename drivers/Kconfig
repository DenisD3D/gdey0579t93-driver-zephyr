## drivers/ssd1683dual/Kconfig
```kconfig
# SSD16XX display controller configuration options

# Copyright (c) 2018 Phytec Messtechnik GmbH
# SPDX-License-Identifier: Apache-2.0

config SSD1683DUAL
	bool "SSD1683 dual compatible display controller driver"
	default y
	depends on \
		DT_HAS_SOLOMON_SSD1683DUAL_ENABLED
	select MIPI_DBI
	help
	  Enable driver for SSD1683 dual compatible controller.
```

## dts/bindings/solomon,ssd1683dual.yaml
```yaml
# Copyright (c) 2022 Andreas Sandberg
# SPDX-License-Identifier: Apache-2.0

description: Solomon Systech Dual SSD1683 400x300 EPD display controller

compatible: "solomon,ssd1683dual"

include: solomon,ssd16xx-common.yaml
```
